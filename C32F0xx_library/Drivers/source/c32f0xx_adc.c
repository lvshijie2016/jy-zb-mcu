/*****************************************************************************
 *   c32f0xx_adc.c:  Header file for C32F0
 *
 *   Copyright(C) 2015,
 *   All rights reserved.
 *
 *   History
 *   2015.07.21  ver 1.01    Prelimnary version
 *
******************************************************************************/
/* Includes ------------------------------------------------------------------*/

#include "c32f0xx.h"
#include "c32f0xx_sys.h"
#include "c32f0xx_adc.h"

extern uint32_t SystemCoreClock;

/*****************************************************************************
Function Name	ADC_Init
Function Definition	void ADC_Init(uint32_t conversionrate)
Function Description	Initial ADC module
Input Parameters	Conversionrate: conversion rate, must less 1000000 (1MHz)
Return Value	No
Condition	No
Function called	-

Last Chang Date: 2015/09/12	
*****************************************************************************/
void ADC_Init(uint32_t conversionrate)
{
    uint32_t temp,div;

    //Power up ADC
    (*SYSCON).PDRUNCFG.bit.ADC_PD = 0;

    //enable clock of ADC digital
    (*SYSCON).SYSAHBCLKCTRL.bit.ADCCLK = 1;

    //reset ADC digital
    (*SYSCON).PRESETCTRL.bit.ADC_RST_N = 0;
    (*SYSCON).PRESETCTRL.bit.ADC_RST_N = 1;

    //limit convertion rate to 1M/s
    if (conversionrate>1000000)
    {
        conversionrate = 1000000;
    }
    conversionrate=conversionrate<<4;

    //caculate clk divider
    div = SystemCoreClock/conversionrate;

    if (((div*conversionrate)!=SystemCoreClock)&&(SystemCoreClock>16000000*div))
    {
        div++;
    }
    	
    //set up divider
    (*ADC).CR.bit.CLKDIV = div;

		
		//insert a delay
    temp=0xff;
    while (temp--);
		
    //select external sample clk
    (*ADC).CR.bit.SCMODE = 1;    
    
    

	//wait untile adc ready
	//if((*ADC).CR.bit.BURST == TRIGGERMODE)
	//{
		//while((*ADC).STAT.bit.ADCRDY == 0);
	//}

    return;
}
/*****************************************************************************
Function Name	ADC_DeInit
Function Definition	Void ADC_DeInit(viod)
Function Description	De_Initial ADC module. Disable interrupt generated by module and stop any conversion.
Input Parameters	No
Return Value	No
Condition	No
Function called	-

Last Chang Date: 2015/09/12	
*****************************************************************************/
void ADC_DeInit(void)
{
    ADC->INTEN.all=0;
    ADC->STAT.all = 0xFFFFFFFF;
    
    //Power down ADC
    (*SYSCON).PDRUNCFG.bit.ADC_PD = 1;
    
    //disable clock of ADC digital
    (*SYSCON).SYSAHBCLKCTRL.bit.ADCCLK = 0;

    return;
}

/*****************************************************************************
Function Name	ADC_SelectTriggerSource
Function Definition	void ADC_SelectTriggerSource(uint8_t triggermode,uint8_t triggersrc, uint8_t edge)
Function Description	Setup trigger source 
Input Parameters	
                               triggermode:select one option
                                                                      TRIGGERMODE
                                                                      BURSTMODE
                                                 
                               Triggersrc: select one option
										ADC_TRIGGER_SOFTWAER, 
										ADC_TRIGGER_CT16B2_CAP0, 
										ADC_TRIGGER_CT16B2_CAP1, 
										ADC_TRIGGER_CT16B2_MAT0,
										ADC_TRIGGER_CT16B2_MAT1,
										ADC_TRIGGER_CT16B3_MAT0,
										ADC_TRIGGER_CT16B3_MAT1,
										ADC_TRIGGER_PWM
Return Value	No
Condition	No
Function called	-

Last Chang Date: 2015/09/12	
*****************************************************************************/
void ADC_SelectTriggerSource(uint8_t triggermode,uint8_t triggersrc, uint8_t edge)
{
    (*ADC).CR.bit.BURST = triggermode;

    if (BURSTMODE == triggermode)
    {
        (*ADC).CR.bit.START = 0;  
    }
    else//TRIGGERMODE
    {
        (*ADC).CR.bit.START = triggersrc;
        (*ADC).CR.bit.EDGE	= edge;		   
    }
    
    //ADC_WaitAdcReady();
    
    return;
}
/*****************************************************************************
Function Name	ADC_SetHighCmp0
Function Definition	void ADC_SetHighCmp0(uint32_t val, uint8_t selchannel)
Function Description	Setup high limit register 0 value and channel to be compare
Input Parameters	val: 	high limit value
				selchannel: one of AD0~AD7
Return Value	No
Condition	No
Function called	-

Last Chang Date: 2015/09/12	
*****************************************************************************/
void ADC_SetHighCmp0(uint32_t val, uint8_t selchannel)
{
    (*ADC).HILMT.bit.HILMT0 = val;
    (*ADC).HILMT.bit.CHNSEL0 = selchannel;
    return;
}
/*****************************************************************************
Function Name	ADC_SetHighCmp1
Function Definition	void ADC_SetHighCmp1(uint32_t val, uint8_t selchannel)
Function Description	Setup high limit register 1 value and channel to be compare
Input Parameters		val: high limit value
					selchannel: one of AD0~AD7
Return Value	No
Condition	No
Function called	-

Last Chang Date: 2015/09/12	
*****************************************************************************/
void ADC_SetHighCmp1(uint32_t val, uint8_t selchannel)
{
    (*ADC).HILMT.bit.HILMT1 = val;
    (*ADC).HILMT.bit.CHNSEL1 = selchannel;
    return;
}
	
/*****************************************************************************
Function Name	ADC_SetLowCmp0
Function Definition	void ADC_SetLowCmp0(uint32_t val, uint8_t selchannel)
Function Description	Setup low limit register 0 value and channel to be compare
Input Parameters		val: high limit value
					selchannel: one of AD0~AD7
Return Value	No
Condition	No
Function called	-

Last Chang Date: 2015/09/12	
*****************************************************************************/
void ADC_SetLowCmp0(uint32_t val, uint8_t selchannel)
{
    (*ADC).LOLMT.bit.LOLMT0 = val;
    (*ADC).LOLMT.bit.CHNSEL0 = selchannel;
    return;
}
/*****************************************************************************
Function Name	ADC_SetLowCmp1
Function Definition	void ADC_SetLowCmp1(uint32_t val, uint8_t selchannel)
Function Description	Setup low limit register 1 value and channel to be compare
Input Parameters			val: high limit value
						selchannel: one of AD0~AD7
Return Value	No
Condition	No
Function called	-

Last Chang Date: 2015/09/12	
*****************************************************************************/
void ADC_SetLowCmp1(uint32_t val, uint8_t selchannel)
{
    (*ADC).LOLMT.bit.LOLMT1 = val;
    (*ADC).LOLMT.bit.CHNSEL1 = selchannel;
    return;
}
/*****************************************************************************
Function Name	ADC_EnableConversionInt
Function Definition	Void ADC_EnableConversionInt(uint32_t inttype)
Function Description	Setup conversion completed interrupt
Input Parameters		inttype: combination of interrupt source-
						     bit 0~7 related to ADC_DR0~ ADC_DR7 value updated
						     bit 8 related ADC global register updated
Return Value	No
Condition	No
Function called	-

Last Chang Date: 2015/09/12	
*****************************************************************************/
void ADC_EnableConversionInt(uint32_t inttype)
{
    (*ADC).INTEN.all =  inttype;
    return;
}
/*****************************************************************************
Function Name	ADC_GetConversionData
Function Definition	uint32_t ADC_GetConversionData(uint8_t dr)
Function Description	Read conversion data 
Input Parameters	dr: data register ADC_DR0~ ADC_DR7
Return Value	Conversion value. If no new value, return 0xFFFF FFFF. GDR value bit 14:12 value represent ADC channel 0~7
Condition	No
Function called	-

Last Chang Date: 2015/09/12	
*****************************************************************************/
uint32_t ADC_GetConversionData(uint8_t dr)
{
    uint32_t DRvalue;
    //do
    //{
        DRvalue = (*ADC).DR[dr].all;
    //}while(( DRvalue & 0x80000000) == 0);
    /*
    为什么使用1MHz的转换速率不会死循环在上面的while循环里面？
    
    因为之前是只要有中断进入，就读取两个通道的数据，没有判断是哪个通道触发的中断
    当使用最高采样速率的时候，一个通道触发中断，另外一个通道也转换完成了，所以不会在上面的while中死循环
    
    当采用低速采样的时候，一个通道采样完成触发中断，但是因为速率低，另外一个通道没有转换完成，在中断里面死循环，
    导致既不能继续采样，又不能退出死循环。
    
    temp0  = ADC_GetConversionData(ADC_DR0);
	temp1  = ADC_GetConversionData(ADC_DR1);
    */

    return DRvalue&0xFFF;
}


/*****************************************************************************
Function Name	ADC_SetupChannels
Function Definition	void ADC_SetupChannels (uint8_t channel, uint8_t data_reg)
Function Description	Select AD channels to be converted
Input Parameters		channel: AD channel and DR assignment. 
                                   data_reg:Ref CHSEL register description. 
Return Value	No
Condition	No
Function called	-

Last Chang Date: 2015/09/12	
*****************************************************************************/

void ADC_SetupChannels (uint8_t channel, uint8_t data_reg)
{
    (*ADC).CHSEL.all &= (~(0x0000000f << (channel * 4)));
    (*ADC).CHSEL.all |= (data_reg << (channel * 4));
}


/*****************************************************************************
Function Name	ADC_EnableChannels
Function Definition	void ADC_EnableChannels(uint8_t channel)
Function Description	Select AD channels to be enable
Input Parameters		channel: AD channel.    
                                   Example  ADC_EnableChannels(ADC_CHN0_ENABLE | ADC_CHN1_ENABLE)
Return Value	No
Condition	No
Function called	-

Last Chang Date: 2015/09/12	
*****************************************************************************/

void ADC_EnableChannels(uint8_t channel)
{
	ADC->CR.bit.CNVEN |= channel;
}


/*****************************************************************************
Function Name	ADC_EnableChannels
Function Definition	void ADC_EnableChannels(uint8_t channel)
Function Description	Select AD channels to be enable
Input Parameters		channel: AD channel.    
                                   Example  ADC_DisableChannels(ADC_CHN0_ENABLE | ADC_CHN1_ENABLE)
Return Value	No
Condition	No
Function called	-

Last Chang Date: 2015/09/12	
*****************************************************************************/

void ADC_DisableChannels(uint8_t channel)
{
	ADC->CR.bit.CNVEN &= (~channel);
}


/*****************************************************************************
Function Name	ADC_WaitAdcReady
Function Definition	void ADC_WaitAdcReady(void)
Function Description	wait adc ready
Input Parameters		None
Return Value	No
Condition	No
Function called	-
Last Chang Date: 2015/09/12	
*****************************************************************************/
void ADC_WaitAdcReady(void)
{
	while(!ADC->STAT.bit.ADCRDY );
}


/******************************************************************************
**                            End Of File
******************************************************************************/
